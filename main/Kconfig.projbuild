## main/Kconfig.projbuild
```kconfig
menu "IGNACC Controller"

    menu "Relays"

        config IGNACC_RELAY_COUNT
            int "Number of relay channels"
            range 1 14
            default 2
            help
                How many relays (IN1..INn) this board drives. Up to 14: every
                ESP32-WROOM-32 GPIO that is output-capable and safe at boot.
                Each channel's GPIO is set below. The protocol, STATUS reply,
                ALL_ON/ALL_OFF and the state machine adapt automatically.

        config IGNACC_RELAY1_GPIO
            int "IN1 relay GPIO"
            range 0 33
            default 26
            help
                GPIO driving relay input IN1. Must be a safe pin:
                4, 13, 16, 17, 18, 19, 21, 22, 23, 25, 26, 27, 32 or 33
                (no strapping, flash, UART, boot-PWM or input-only pins).
                The build fails if an unsafe or duplicate pin is chosen.

        config IGNACC_RELAY2_GPIO
            int "IN2 relay GPIO" if IGNACC_RELAY_COUNT >= 2
            range 0 33
            default 27
            help
                GPIO driving relay input IN2. Same rules as IN1.

        config IGNACC_RELAY3_GPIO
            int "IN3 relay GPIO" if IGNACC_RELAY_COUNT >= 3
            range 0 33
            default 25
            help
                GPIO driving relay input IN3. Same rules as IN1.

        config IGNACC_RELAY4_GPIO
            int "IN4 relay GPIO" if IGNACC_RELAY_COUNT >= 4
            range 0 33
            default 33
            help
                GPIO driving relay input IN4. Same rules as IN1.

        config IGNACC_RELAY5_GPIO
            int "IN5 relay GPIO" if IGNACC_RELAY_COUNT >= 5
            range 0 33
            default 32
            help
                GPIO driving relay input IN5. Same rules as IN1.

        config IGNACC_RELAY6_GPIO
            int "IN6 relay GPIO" if IGNACC_RELAY_COUNT >= 6
            range 0 33
            default 4
            help
                GPIO driving relay input IN6. Same rules as IN1.

        config IGNACC_RELAY7_GPIO
            int "IN7 relay GPIO" if IGNACC_RELAY_COUNT >= 7
            range 0 33
            default 13
            help
                GPIO driving relay input IN7. Same rules as IN1.

        config IGNACC_RELAY8_GPIO
            int "IN8 relay GPIO" if IGNACC_RELAY_COUNT >= 8
            range 0 33
            default 16
            help
                GPIO driving relay input IN8. Same rules as IN1.

        config IGNACC_RELAY9_GPIO
            int "IN9 relay GPIO" if IGNACC_RELAY_COUNT >= 9
            range 0 33
            default 17
            help
                GPIO driving relay input IN9. Same rules as IN1.

        config IGNACC_RELAY10_GPIO
            int "IN10 relay GPIO" if IGNACC_RELAY_COUNT >= 10
            range 0 33
            default 18
            help
                GPIO driving relay input IN10. Same rules as IN1.

        config IGNACC_RELAY11_GPIO
            int "IN11 relay GPIO" if IGNACC_RELAY_COUNT >= 11
            range 0 33
            default 19
            help
                GPIO driving relay input IN11. Same rules as IN1.

        config IGNACC_RELAY12_GPIO
            int "IN12 relay GPIO" if IGNACC_RELAY_COUNT >= 12
            range 0 33
            default 21
            help
                GPIO driving relay input IN12. Same rules as IN1.

        config IGNACC_RELAY13_GPIO
            int "IN13 relay GPIO" if IGNACC_RELAY_COUNT >= 13
            range 0 33
            default 22
            help
                GPIO driving relay input IN13. Same rules as IN1.

        config IGNACC_RELAY14_GPIO
            int "IN14 relay GPIO" if IGNACC_RELAY_COUNT >= 14
            range 0 33
            default 23
            help
                GPIO driving relay input IN14. Same rules as IN1.

        choice IGNACC_RELAY_ACTIVE_LEVEL
            prompt "Relay active level"
            default IGNACC_RELAY_ACTIVE_LOW
            help
                Pin level that switches a relay ON.

            config IGNACC_RELAY_ACTIVE_LOW
                bool "Active LOW (pin LOW = relay ON)"
            config IGNACC_RELAY_ACTIVE_HIGH
                bool "Active HIGH (pin HIGH = relay ON)"
        endchoice

        config IGNACC_RELAY_ACTIVE_LEVEL
            int
            default 0 if IGNACC_RELAY_ACTIVE_LOW
            default 1 if IGNACC_RELAY_ACTIVE_HIGH

        config IGNACC_RELAY_SETTLE_MS
            int "Relay settle delay (ms)"
            range 0 1000
            default 15
            help
                Delay between driving a relay pin and sending the _OK response.
                Covers relay operate time (<= 10 ms) plus contact bounce.

    endmenu

    menu "UART link"

        config IGNACC_UART_PORT
            int "UART port number"
            range 0 2
            default 0
            help
                UART0 is wired to the on-board USB-UART bridge.

        config IGNACC_UART_BAUD
            int "Baud rate"
            range 1200 921600
            default 115200

        config IGNACC_UART_TX_GPIO
            int "UART TX GPIO"
            range 0 33
            default 1

        config IGNACC_UART_RX_GPIO
            int "UART RX GPIO"
            range 0 39
            default 3

        config IGNACC_UART_RX_BUF_SIZE
            int "UART driver RX ring buffer size (bytes)"
            range 256 4096
            default 256
            help
                Must be larger than the hardware FIFO (128 bytes).

        config IGNACC_UART_EVENT_QUEUE_LEN
            int "UART driver event queue length"
            range 4 64
            default 16

        config IGNACC_MAX_LINE_LEN
            int "Maximum command line length (chars)"
            range 4 128
            default 32
            help
                Excluding the line terminator. Longer lines are discarded entirely.

    endmenu

    menu "Tasks"

        config IGNACC_CMD_QUEUE_DEPTH
            int "Command queue depth (lines)"
            range 1 32
            default 4
            help
                Complete lines waiting for the state machine. When full, new
                lines are dropped (no response is sent for them).

        config IGNACC_UART_TASK_PRIORITY
            int "UART RX task priority"
            range 1 24
            default 10

        config IGNACC_UART_TASK_STACK
            int "UART RX task stack size (bytes)"
            range 2048 16384
            default 3072

        config IGNACC_FSM_TASK_PRIORITY
            int "State machine task priority"
            range 1 24
            default 9

        config IGNACC_FSM_TASK_STACK
            int "State machine task stack size (bytes)"
            range 2048 16384
            default 3072

    endmenu

endmenu
```
